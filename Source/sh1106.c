#include "OSAL.h"
#include "OnBoard.h"
#include "hal_assert.h"
#include "hal_types.h"
#include "sh1106.h"

/**
  LCD pins

  // control pins
  P1.1 - LCD_RESET
  P1.2 - LCD_CS chip select
  P1.3 - LCD_DC Data / Command

  // spi
  P1.4 - SSN - not used
  P1.5 - CLK
  P1.6 - MOSI
  P1.7 - MISO - not used
*/

#define SCREEN_WIDTH  128
#define SCREEN_HEIGHT 64

// LCD Control lines
#define LCD_RESET_PORT 1
#define LCD_RESET_PIN  1
#define LCD_CS_PORT 1
#define LCD_CS_PIN  2
#define LCD_MODE_PORT 1
#define LCD_MODE_PIN  3

// LCD SPI lines
#define LCD_CLK_PORT 1
#define LCD_CLK_PIN  5
#define LCD_MOSI_PORT 1
#define LCD_MOSI_PIN  6
#define LCD_MISO_PORT 1
#define LCD_MISO_PIN  7

// Defines for HW LCD

#define IO_SET(port, pin, val)        IO_SET_PREP(port, pin, val)
#define IO_SET_PREP(port, pin, val)   st( P##port##_##pin = val; )

#define CONFIG_IO_OUTPUT(port, pin, val)      CONFIG_IO_OUTPUT_PREP(port, pin, val)
#define CONFIG_IO_OUTPUT_PREP(port, pin, val) st( P##port##SEL &= ~BV(pin); \
                                                      P##port##_##pin = val; \
                                                      P##port##DIR |= BV(pin); )

#define CONFIG_IO_PERIPHERAL(port, pin)      CONFIG_IO_PERIPHERAL_PREP(port, pin)
#define CONFIG_IO_PERIPHERAL_PREP(port, pin) st( P##port##SEL |= BV(pin); )

// SPI interface control
#define LCD_SPI_BEGIN()     IO_SET(LCD_CS_PORT,  LCD_CS_PIN,  0); // activate chip select
#define LCD_SPI_END() {                                               \
  asm("NOP");                                                         \
  asm("NOP");                                                         \
  asm("NOP");                                                         \
  asm("NOP");                                                         \
  IO_SET(LCD_CS_PORT,  LCD_CS_PIN,  1); /* deactivate chip select */  \
}

// macros for transmit byte
// clear the received and transmit byte status, write tx data to buffer, wait till transmit done
#define LCD_SPI_TX(x)          { U1CSR &= ~(BV(2) | BV(1)); U1DBUF = x; while(!(U1CSR & BV(1))); }

// macros for DC pin control
#define LCD_DO_WRITE()        IO_SET(LCD_MODE_PORT,  LCD_MODE_PIN,  1);
#define LCD_DO_CONTROL()      IO_SET(LCD_MODE_PORT,  LCD_MODE_PIN,  0);

#define LCD_ACTIVATE_RESET()  IO_SET(LCD_RESET_PORT, LCD_RESET_PIN, 0);
#define LCD_RELEASE_RESET()   IO_SET(LCD_RESET_PORT, LCD_RESET_PIN, 1);

extern const uint8 SmallFont[];

static void SPI_Config(void);

static void SH1106_WC(uint8 cmd);

static void SH1106_FillScreen(void);

void SH1106_Print(uint8 x, uint8 y, const char *str);

/**
 *  Configure IO lines needed for LCD control.
 */
static void SH1106_ConfigIO(void) {
    // GPIO configuration
    CONFIG_IO_OUTPUT(LCD_MODE_PORT, LCD_MODE_PIN, 1);
    CONFIG_IO_OUTPUT(LCD_RESET_PORT, LCD_RESET_PIN, 1);
    CONFIG_IO_OUTPUT(LCD_CS_PORT, LCD_CS_PIN, 1);
}

/**
 * Configure SPI lines needed for talking to LCD.
 */
static void SPI_Config(void) {
    // Set SPI on UART 1 alternative 2
    PERCFG |= 0x02;

    /* Configure SPI pins: clk, master out and master in */
    CONFIG_IO_PERIPHERAL(LCD_CLK_PORT, LCD_CLK_PIN);
    CONFIG_IO_PERIPHERAL(LCD_MOSI_PORT, LCD_MOSI_PIN);
    CONFIG_IO_PERIPHERAL(LCD_MISO_PORT, LCD_MISO_PIN);

    // Set SPI speed to 1 MHz (the values assume system clk of 32MHz)
    // Confirm on board that this results in 1MHz spi clk.
    const uint8 baud_exponent = 15;
    const uint8 baud_mantissa = 0;

// SPI settings
#define SPI_CLOCK_POL_LO       0x00
#define SPI_CLOCK_PHA_0        0x00
#define SPI_TRANSFER_MSB_FIRST 0x20

    // Configure SPI
    U1UCR = 0x80;      // Flush and goto IDLE state. 8-N-1.
    U1CSR = 0x00;      // SPI mode, master.
    U1GCR = SPI_TRANSFER_MSB_FIRST | SPI_CLOCK_PHA_0 | SPI_CLOCK_POL_LO | baud_exponent;
    U1BAUD = baud_mantissa;
}

/**
 * Send 1 byte command
 */
static void SH1106_WC(uint8 cmd) {
    LCD_SPI_BEGIN()
    LCD_DO_CONTROL()
    LCD_SPI_TX(cmd)
    LCD_SPI_END()
}

/**
 * Initialize SH1106 screen and SPI
 */
void SH1106_Init() {
    const uint8 contrast = 40; // 0-255
    const uint8 bright = 0x22;
    const uint8 mirror = 0;    // 0 or 1

    // Initialize LCD IO lines
    SH1106_ConfigIO();

    // Initialize SPI
    SPI_Config();

    // Perform reset
    LCD_ACTIVATE_RESET()
    HW_DelayUs(15000); // 15 ms
    LCD_RELEASE_RESET()
    HW_DelayUs(15);    // 15 us

    // Init SH1106
    SH1106_WC(0xAE); // display off
    SH1106_WC(0xA8); // set multiplex ratio(1 to 64)
    SH1106_WC(0x3F);
    SH1106_WC(0x81); // set contrast control register
    SH1106_WC(contrast);
    if (mirror) {
        SH1106_WC(0xA0);
        SH1106_WC(0xC0);
    } else {
        SH1106_WC(0xA1);
        SH1106_WC(0xC8);
    }
    SH1106_WC(0xDA); // Common Pads Hardware Configuration (Alternative Mode Set)
    SH1106_WC(0x12);
    SH1106_WC(0xD3); // Set Display Offset
    SH1106_WC(0x00);
    SH1106_WC(0x40); // Set Display Start Line 0
    SH1106_WC(0xD9); // set pre-charge period
    SH1106_WC(bright);
    SH1106_WC(0xAF); // turn on SSD1306 panel

    SH1106_FillScreen();
    SH1106_Print(2, 0, "PZEM Monitor v1.0");
}

/**
 * Fill screen black
 */
static void SH1106_FillScreen(void) {
    uint8 i, j;
    for (i = 0; i < 8; i++) {
        SH1106_WC(0xB0 + i);
        SH1106_WC(2);
        SH1106_WC(0x10);

        LCD_SPI_BEGIN()
        LCD_DO_WRITE()
        for (j = 0; j < SCREEN_WIDTH; j++) {
            LCD_SPI_TX(0)
        }
        LCD_SPI_END()
    }
}

/**
 * Print string to screen
 * @param x column of first char
 * @param y row of first char
 * @param str string for print. 0x00 at the string end
 */
void SH1106_Print(uint8 x, uint8 y, const char *str) {
    const uint8 fontWidth = 6;
    uint8 code;
    uint8 start;
    uint16 dFont;

    // select page: 0-7
    SH1106_WC(0xB0 + y);
    // set first pixel(row) in the page: 2-130
    start = x * fontWidth + 2;
    SH1106_WC(0x0f & start);
    SH1106_WC(0x0f & (start >> 4) | 0x10);

    LCD_SPI_BEGIN()
    LCD_DO_WRITE()

    while (1) {
        code = *str++;
        if (code < 32) {
            break;
        }
        dFont = fontWidth * (code - 32);
        for (uint8 j = 0; j < fontWidth; j++) {
            LCD_SPI_TX(SmallFont[dFont++])
        }
    }

    LCD_SPI_END()
}

/**
 * Erase chars.
 * @param x - column of first char
 * @param y - row of first char
 * @param count - number of characters to be erased
 */
void SH1106_Erase(uint8 x, uint8 y, uint8 count) {
    const uint8 fontWidth = 6;
    uint8 start;

    // select page: 0-7
    SH1106_WC(0xB0 + y);
    // set first pixel(row) in the page: 2-130
    start = x * fontWidth + 2;
    SH1106_WC(0x0f & start);
    SH1106_WC(0x0f & (start >> 4) | 0x10);

    LCD_SPI_BEGIN()
    LCD_DO_WRITE()
    for (uint8 j = 0; j < count * fontWidth; j++) {
        LCD_SPI_TX(0)
    }
    LCD_SPI_END()
}


/**
 * Wait for x us. @ 32MHz MCU clock it takes 32 "nop"s for 1 us delay.
 */
void HW_DelayUs(uint16 microSecs) {
    while (microSecs--) {
        /* 32 NOPs == 1 usecs */
        asm("nop"); asm("nop"); asm("nop"); asm("nop"); asm("nop");
        asm("nop"); asm("nop"); asm("nop"); asm("nop"); asm("nop");
        asm("nop"); asm("nop"); asm("nop"); asm("nop"); asm("nop");
        asm("nop"); asm("nop"); asm("nop"); asm("nop"); asm("nop");
        asm("nop"); asm("nop"); asm("nop"); asm("nop"); asm("nop");
        asm("nop"); asm("nop"); asm("nop"); asm("nop"); asm("nop");
        asm("nop"); asm("nop");
    }
}

// Шрифт SmallFont
const uint8 SmallFont[] = {
        0x00, 0x00, 0x00, 0x00, 0x00, 0x00,   // 001) 0x20=032 пробел
        0x00, 0x00, 0x00, 0x2F, 0x00, 0x00,   // 002) 0x21=033 !
        0x00, 0x00, 0x07, 0x00, 0x07, 0x00,   // 003) 0x22=034 "
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        0x00, 0x00, 0x06, 0x09, 0x09, 0x06    // 095  0x7E=126 ~
};
